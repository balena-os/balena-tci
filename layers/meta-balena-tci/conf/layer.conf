## layers/meta-balena-tci/conf/layer.conf
```bitbake
# We have a conf and classes directory, add to BBPATH
BBPATH .= ":${LAYERDIR}"

# We have recipes-* directories, add to BBFILES
BBFILES += "${LAYERDIR}/recipes-*/*/*.bb \
	    ${LAYERDIR}/recipes-*/*/*.bbappend"

BBFILE_COLLECTIONS += "balena-tci"
BBFILE_PATTERN_balena-tci := "^${LAYERDIR}/"
BBFILE_PRIORITY_balena-tci = "1337"

LAYERDEPENDS_balena-tci = "rockchip"

# This should only be incremented on significant changes that will
# cause compatibility issues with other layers
LAYERVERSION_balena-tci = "1"
LAYERSERIES_COMPAT_balena-tci = "honister"

# the BSP generates this image type which we do not use and also causes a circular dependency error
IMAGE_FSTYPES:remove = "wic"

# mask BSP patch which fails to apply and which we have no use for
BBMASK += "meta-rockchip/recipes-core/systemd/systemd"

# workaround larger initramfs kernel which would make the board not boot
KERNEL_IMAGETYPE = "zImage"
```
